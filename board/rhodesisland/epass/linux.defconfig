## board/rhodesisland/epass/linux.defconfig
```kconfig
CONFIG_KERNEL_LZ4=y
CONFIG_NO_HZ=y
CONFIG_HIGH_RES_TIMERS=y
CONFIG_LOG_BUF_SHIFT=14
CONFIG_PRINTK_SAFE_LOG_BUF_SHIFT=12
CONFIG_CC_OPTIMIZE_FOR_SIZE=y
CONFIG_KALLSYMS=y
CONFIG_EMBEDDED=y
# CONFIG_ARCH_MULTI_V7 is not set
CONFIG_ARCH_SUNXI=y
CONFIG_AEABI=y
# CONFIG_ARM_MODULE_PLTS is not set
CONFIG_ARM_APPENDED_DTB=y
CONFIG_ARM_ATAG_DTB_COMPAT=y
CONFIG_CMDLINE="net.ifnames=0 vt.global_cursor_default=0"
CONFIG_CMDLINE_EXTEND=y
# CONFIG_STRICT_KERNEL_RWX is not set
CONFIG_STRICT_MODULE_RWX=y
CONFIG_MODULES=y
CONFIG_MODULE_UNLOAD=y
CONFIG_CMA=y
CONFIG_ZSMALLOC=y
CONFIG_NET=y
CONFIG_UNIX=y
# CONFIG_WIRELESS is not set
CONFIG_UEVENT_HELPER=y
CONFIG_DEVTMPFS=y
CONFIG_DEVTMPFS_MOUNT=y
CONFIG_SUNXI_RSB=y
CONFIG_MTD=y
CONFIG_MTD_BLOCK=y
CONFIG_MTD_OF_PARTS=y
CONFIG_MTD_SPI_NAND=y
CONFIG_MTD_UBI=y
CONFIG_MTD_UBI_FASTMAP=y
CONFIG_ZRAM=y
CONFIG_INPUT_EVDEV=y
CONFIG_INPUT_MISC=y
CONFIG_INPUT_AXP20X_PEK=y
# CONFIG_KEYBOARD_ATKBD is not set
CONFIG_KEYBOARD_SUN4I_LRADC=y
CONFIG_KEYBOARD_GPIO_POLLED=y
# CONFIG_INPUT_MOUSE is not set
# CONFIG_SERIO_SERPORT is not set
# CONFIG_VT is not set
# CONFIG_LEGACY_PTYS is not set
CONFIG_SERIAL_8250=y
CONFIG_SERIAL_8250_CONSOLE=y
CONFIG_SERIAL_8250_NR_UARTS=3
CONFIG_SERIAL_8250_RUNTIME_UARTS=3
CONFIG_SERIAL_8250_DW=y
CONFIG_SERIAL_OF_PLATFORM=y
# CONFIG_HW_RANDOM is not set
CONFIG_I2C_CHARDEV=y
CONFIG_I2C_MUX=y
CONFIG_I2C_GPIO=y
CONFIG_I2C_MV64XXX=y
CONFIG_SPI=y
CONFIG_SPI_SUN6I=y
CONFIG_SPI_SPIDEV=y
CONFIG_GPIO_SYSFS=y
CONFIG_POWER_RESET=y
CONFIG_POWER_RESET_GPIO=y
CONFIG_POWER_SUPPLY=y
CONFIG_GENERIC_ADC_BATTERY=y
CONFIG_BATTERY_AXP20X=y
CONFIG_CHARGER_AXP20X=y
CONFIG_AXP20X_POWER=y
# CONFIG_HWMON is not set
CONFIG_WATCHDOG=y
CONFIG_SUNXI_WATCHDOG=y
CONFIG_MFD_SUN4I_GPADC=y
CONFIG_MFD_SYSCON=y
CONFIG_MFD_AXP20X=y
CONFIG_MFD_AXP20X_I2C=y
CONFIG_REGULATOR=y
CONFIG_REGULATOR_FIXED_VOLTAGE=y
CONFIG_REGULATOR_AXP20X=y
CONFIG_MEDIA_SUPPORT=y
CONFIG_MEDIA_CAMERA_SUPPORT=y
CONFIG_MEDIA_CONTROLLER=y
CONFIG_MEDIA_CONTROLLER_REQUEST_API=y
CONFIG_DRM=y
# CONFIG_DRM_FBDEV_EMULATION is not set
CONFIG_DRM_SUN4I=y
# CONFIG_DRM_SUN4I_HDMI is not set
CONFIG_DRM_SUN4I_PANIC=y
CONFIG_DRM_PANEL_SIMPLE=y
CONFIG_BACKLIGHT_CLASS_DEVICE=y
# CONFIG_BACKLIGHT_GENERIC is not set
CONFIG_BACKLIGHT_PWM=y
CONFIG_BACKLIGHT_GPIO=y
CONFIG_SOUND=m
CONFIG_SND=m
CONFIG_SND_SOC=m
CONFIG_SND_SUN4I_I2S=m
CONFIG_SND_SOC_ES8311=m
CONFIG_SND_SIMPLE_CARD=m
# CONFIG_HID is not set
# CONFIG_USB_HID is not set
CONFIG_USB=y
CONFIG_USB_DYNAMIC_MINORS=y
CONFIG_USB_OTG=y
CONFIG_USB_MUSB_HDRC=y
CONFIG_USB_MUSB_SUNXI=y
CONFIG_NOP_USB_XCEIV=y
CONFIG_USB_GADGET=y
CONFIG_USB_GADGET_VBUS_DRAW=100
CONFIG_USB_CONFIGFS=y
CONFIG_USB_CONFIGFS_ACM=y
CONFIG_USB_CONFIGFS_F_FS=y
CONFIG_MMC=y
CONFIG_MMC_SUNXI=y
CONFIG_DMADEVICES=y
# CONFIG_VIRTIO_MENU is not set
CONFIG_STAGING=y
CONFIG_SHIROGANE=y
CONFIG_SHIROGANE_SIMPLE_ST7701_INIT=y
CONFIG_SHIROGANE_KEYBOARD_CARDKB=m
CONFIG_STAGING_MEDIA=y
CONFIG_VIDEO_SUNXI=y
CONFIG_VIDEO_SUNXI_CEDRUS=y
CONFIG_SUN8I_A83T_CCU=y
CONFIG_SUN8I_DE2_CCU=y
CONFIG_SUN8I_R_CCU=y
# CONFIG_IOMMU_SUPPORT is not set
CONFIG_IIO=y
CONFIG_SUN4I_GPADC=y
CONFIG_AXP20X_ADC=y
CONFIG_IIO_RESCALE=y
CONFIG_IIO_ST_LSM6DSX=m
CONFIG_PWM=y
CONFIG_PWM_SUN4I=y
CONFIG_PHY_SUN4I_USB=y
# CONFIG_NVMEM is not set
CONFIG_EXT4_FS=y
CONFIG_VFAT_FS=y
CONFIG_TMPFS=y
CONFIG_UBIFS_FS=y
CONFIG_UBIFS_FS_ADVANCED_COMPR=y
# CONFIG_UBIFS_FS_ZSTD is not set
# CONFIG_NETWORK_FILESYSTEMS is not set
CONFIG_NLS_CODEPAGE_437=y
CONFIG_NLS_ISO8859_1=y
CONFIG_NLS_UTF8=y
CONFIG_CRYPTO_HMAC=y
CONFIG_CRYPTO_SHA256=y
CONFIG_CRYPTO_DEV_SUN4I_SS=y
CONFIG_CRYPTO_DEV_SUN4I_SS_PRNG=y
CONFIG_XZ_DEC=y
CONFIG_DMA_CMA=y
CONFIG_CMA_SIZE_MBYTES=4
CONFIG_CMA_ALIGNMENT=4
CONFIG_PRINTK_TIME=y
CONFIG_DEBUG_FS=y
# CONFIG_FTRACE is not set
# CONFIG_RUNTIME_TESTING_MENU is not set
```

## board/rhodesisland/epass/rhodesisland_epass_defconfig
```kconfig
BR2_arm=y
BR2_TOOLCHAIN_BUILDROOT_MUSL=y
BR2_GCC_ENABLE_LTO=y
BR2_PACKAGE_HOST_GDB=y
BR2_PACKAGE_HOST_GDB_TUI=y
BR2_PACKAGE_HOST_GDB_PYTHON=y
BR2_PACKAGE_HOST_GDB_SIM=y
BR2_TARGET_GENERIC_HOSTNAME="epass"
BR2_TARGET_GENERIC_ISSUE="Welcome to Rhodes Island Electronic Pass"
BR2_ROOTFS_DEVICE_CREATION_DYNAMIC_MDEV=y
BR2_TARGET_GENERIC_ROOT_PASSWD="toor"
BR2_ROOTFS_OVERLAY="board/allwinner/generic/rootfs board/allwinner/suniv-f1c100s/rootfs board/rhodesisland/epass/rootfs"
BR2_ROOTFS_POST_IMAGE_SCRIPT="board/rhodesisland/epass/scripts/mknanduboot.sh board/rhodesisland/epass/scripts/mkdt.sh board/rhodesisland/epass/scripts/buildimage.sh"
BR2_LINUX_KERNEL=y
BR2_LINUX_KERNEL_CUSTOM_VERSION=y
BR2_LINUX_KERNEL_CUSTOM_VERSION_VALUE="5.4.99"
BR2_LINUX_KERNEL_PATCH="board/allwinner/suniv-f1c100s/patch/linux board/rhodesisland/epass/patch/linux"
BR2_LINUX_KERNEL_USE_CUSTOM_CONFIG=y
BR2_LINUX_KERNEL_CUSTOM_CONFIG_FILE="board/rhodesisland/epass/linux.defconfig"
BR2_LINUX_KERNEL_LZ4=y
BR2_LINUX_KERNEL_DTS_SUPPORT=y
BR2_LINUX_KERNEL_CUSTOM_DTS_PATH="board/allwinner/suniv-f1c100s/devicetree/linux/suniv-f1c100s.dtsi board/rhodesisland/epass/devicetree/linux/base/epass_common.dtsi board/rhodesisland/epass/devicetree/linux/base/epass.dtsi board/rhodesisland/epass/devicetree/linux/base/devicetree-0.3.dts"
BR2_PACKAGE_BUSYBOX_CONFIG_FRAGMENT_FILES="board/rhodesisland/epass/busybox.fragment"
BR2_PACKAGE_EPASS_DRM_APP=y
BR2_PACKAGE_EPASS_APPLICATIONS=y
BR2_PACKAGE_EPASS_USB_RESPONDER=y
BR2_PACKAGE_EPASSCTL=y
BR2_PACKAGE_USB_AIO_HANDLER=y
BR2_PACKAGE_BATTERY_HWCD=y
BR2_PACKAGE_E2FSPROGS_RESIZE2FS=y
BR2_PACKAGE_MTD=y
# BR2_PACKAGE_MTD_FLASHCP is not set
# BR2_PACKAGE_MTD_FLASH_ERASE is not set
# BR2_PACKAGE_MTD_FLASH_LOCK is not set
# BR2_PACKAGE_MTD_FLASH_UNLOCK is not set
# BR2_PACKAGE_MTD_MTD_DEBUG is not set
BR2_PACKAGE_MTD_MTDPART=y
# BR2_PACKAGE_MTD_NANDDUMP is not set
# BR2_PACKAGE_MTD_NANDTEST is not set
# BR2_PACKAGE_MTD_NANDWRITE is not set
BR2_PACKAGE_EPASS_TEST=y
BR2_PACKAGE_FB_TEST_APP=y
BR2_PACKAGE_EVTEST=y
BR2_PACKAGE_MINICOM=y
BR2_PACKAGE_TINYALSA=y
BR2_PACKAGE_GD=y
BR2_PACKAGE_JPEG_TURBO=y
BR2_PACKAGE_LIBDRM_INSTALL_TESTS=y
BR2_PACKAGE_LIBGPIOD=y
BR2_PACKAGE_LIBGPIOD_TOOLS=y
BR2_PACKAGE_MTDEV=y
BR2_PACKAGE_TSLIB=y
BR2_PACKAGE_LIBEVDEV=y
BR2_PACKAGE_LIBFFI=y
BR2_PACKAGE_PCRE=y
BR2_PACKAGE_PCRE2=y
BR2_TARGET_ROOTFS_SQUASHFS=y
BR2_TARGET_ROOTFS_SQUASHFS4_LZO=y
BR2_TARGET_UBOOT=y
BR2_TARGET_UBOOT_BUILD_SYSTEM_KCONFIG=y
BR2_TARGET_UBOOT_CUSTOM_VERSION=y
BR2_TARGET_UBOOT_CUSTOM_VERSION_VALUE="2020.07"
BR2_TARGET_UBOOT_PATCH="board/allwinner/suniv-f1c100s/patch/u-boot board/rhodesisland/epass/patch/uboot"
BR2_TARGET_UBOOT_USE_CUSTOM_CONFIG=y
BR2_TARGET_UBOOT_CUSTOM_CONFIG_FILE="board/rhodesisland/epass/uboot.defconfig"
BR2_TARGET_UBOOT_NEEDS_DTC=y
BR2_TARGET_UBOOT_SPL=y
BR2_TARGET_UBOOT_SPL_NAME="u-boot-sunxi-with-spl.bin"
BR2_TARGET_UBOOT_CUSTOM_DTS_PATH="board/allwinner/suniv-f1c100s/devicetree/uboot/suniv-f1c100s.dtsi board/rhodesisland/epass/devicetree/uboot/suniv-f1c100s-generic.dts"
BR2_PACKAGE_HOST_DOSFSTOOLS=y
BR2_PACKAGE_HOST_E2FSPROGS=y
BR2_PACKAGE_HOST_GENIMAGE=y
BR2_PACKAGE_HOST_MTD=y
BR2_PACKAGE_HOST_MTOOLS=y
BR2_PACKAGE_HOST_PYTHON3=y
BR2_PACKAGE_HOST_PYTHON3_SSL=y
BR2_PACKAGE_HOST_UBOOT_TOOLS=y
BR2_PACKAGE_HOST_UBOOT_TOOLS_FIT_SUPPORT=y
BR2_PACKAGE_HOST_UBOOT_TOOLS_FIT_SIGNATURE_SUPPORT=y
BR2_PACKAGE_HOST_USB_AIO_HANDLER=y
BR2_PACKAGE_HOST_ENVIRONMENT_SETUP=y
```

## board/rhodesisland/epass/scripts/dtbs.its
```
/dts-v1/;
/ {
    description = "ePass DTBs and splash bundle";
    #address-cells = <1>;
    images {
        fdt-base-0.1 {
            description = "base_0.1";
            data = /incbin/("./dt/base/devicetree-0.1.dtb");
            type = "flat_dt";
            arch = "arm";
            compression = "none";
        };
        fdt-base-0.2 {
            description = "base_0.2";
            data = /incbin/("./dt/base/devicetree-0.2.dtb");
            type = "flat_dt";
            arch = "arm";
            compression = "none";
        };
        fdt-base-0.3 {
            description = "base_0.3";
            data = /incbin/("./dt/base/devicetree-0.3.dtb");
            type = "flat_dt";
            arch = "arm";
            compression = "none";
        };
        fdt-base-0.5 {
            description = "base_0.5";
            data = /incbin/("./dt/base/devicetree-0.5.dtb");
            type = "flat_dt";
            arch = "arm";
            compression = "none";
        };
        fdt-base-0.6 {
            description = "base_0.6";
            data = /incbin/("./dt/base/devicetree-0.6.dtb");
            type = "flat_dt";
            arch = "arm";
            compression = "none";
        };
        fdt-base-p0.1 {
            description = "base_p0.1";
            data = /incbin/("./dt/base/devicetree-p0.1.dtb");
            type = "flat_dt";
            arch = "arm";
            compression = "none";
        };

        /* screens */
        fdt-screen-hsd {
            description = "HSD screen overlay";
            data = /incbin/("./dt/screen/hsd.dtbo");
            type = "flat_dt";
            arch = "arm";
            compression = "none";
        };
        fdt-screen-boe {
            description = "BOE screen overlay";
            data = /incbin/("./dt/screen/boe.dtbo");
            type = "flat_dt";
            arch = "arm";
            compression = "none";
        };
        fdt-screen-laowu {
            description = "Laowu screen overlay";
            data = /incbin/("./dt/screen/laowu.dtbo");
            type = "flat_dt";
            arch = "arm";
            compression = "none";
        };
        fdt-screen-hsd_nv3052 {
            description = "HSD NV3052C screen overlay";
            data = /incbin/("./dt/screen/hsd_nv3052.dtbo");
            type = "flat_dt";
            arch = "arm";
            compression = "none";
        };
        fdt-screen-boe_035 {
            description = "BOE 3.5 screen overlay";
            data = /incbin/("./dt/screen/boe_035.dtbo");
            type = "flat_dt";
            arch = "arm";
            compression = "none";
        };

        /* interfaces */
        fdt-iface-adc_pa1 {
            description = "ADC PA1 interface overlay";
            data = /incbin/("./dt/interface/adc_pa1.dtbo");
            type = "flat_dt";
            arch = "arm";
            compression = "none";
        };
        fdt-iface-adc_pa123 {
            description = "ADC PA123 interface overlay";
            data = /incbin/("./dt/interface/adc_pa123.dtbo");
            type = "flat_dt";
            arch = "arm";
            compression = "none";
        };
        fdt-iface-i2c0 {
            description = "I2C0 interface overlay";
            data = /incbin/("./dt/interface/i2c0.dtbo");
            type = "flat_dt";
            arch = "arm";
            compression = "none";
        };
        fdt-iface-i2s0_pa {
            description = "I2S0 PA interface overlay";
            data = /incbin/("./dt/interface/i2s0_pa.dtbo");
            type = "flat_dt";
            arch = "arm";
            compression = "none";
        };
        fdt-iface-i2s0_pe {
            description = "I2S0 PE interface overlay";
            data = /incbin/("./dt/interface/i2s0_pe.dtbo");
            type = "flat_dt";
            arch = "arm";
            compression = "none";
        };
        fdt-iface-spi1 {
            description = "SPI1 interface overlay";
            data = /incbin/("./dt/interface/spi1.dtbo");
            type = "flat_dt";
            arch = "arm";
            compression = "none";
        };
        fdt-iface-uart1 {
            description = "UART1 interface overlay";
            data = /incbin/("./dt/interface/uart1.dtbo");
            type = "flat_dt";
            arch = "arm";
            compression = "none";
        };
        fdt-iface-uart2 {
            description = "UART2 interface overlay";
            data = /incbin/("./dt/interface/uart2.dtbo");
            type = "flat_dt";
            arch = "arm";
            compression = "none";
        };
        fdt-iface-usbhost {
            description = "USB host interface overlay";
            data = /incbin/("./dt/interface/usbhost.dtbo");
            type = "flat_dt";
            arch = "arm";
            compression = "none";
        };
        fdt-iface-usbhs {
            description = "USB HS interface overlay";
            data = /incbin/("./dt/interface/usbhs.dtbo");
            type = "flat_dt";
            arch = "arm";
            compression = "none";
        };

        /* boot splash logos (pre-gzipped RGB565 raw, gunzipped by imxtract) */
        logo-hsd {
            description = "splash logo 360x640 RGB565";
            data = /incbin/("./logo-mostima.rgb565.gz");
            type = "firmware";
            arch = "arm";
            compression = "gzip";
        };
        logo-boe {
            description = "splash logo 360x640 RGB565";
            data = /incbin/("./logo-mostima.rgb565.gz");
            type = "firmware";
            arch = "arm";
            compression = "gzip";
        };
        logo-laowu {
            description = "splash logo 360x640 RGB565";
            data = /incbin/("./logo-mostima.rgb565.gz");
            type = "firmware";
            arch = "arm";
            compression = "gzip";
        };
        logo-hsd_nv3052 {
            description = "splash logo 720x1280 RGB565";
            data = /incbin/("./logo-hsd_nv3052.rgb565.gz");
            type = "firmware";
            arch = "arm";
            compression = "gzip";
        };
        logo-boe_035 {
            description = "splash logo 720x1280 RGB565";
            data = /incbin/("./logo-hsd_nv3052.rgb565.gz");
            type = "firmware";
            arch = "arm";
            compression = "gzip";
        };

        /* exts */
        fdt-ext-cardkb {
            description = "M5Stack CardKB extension overlay";
            data = /incbin/("./dt/ext/cardkb.dtbo");
            type = "flat_dt";
            arch = "arm";
            compression = "none";
        };
        fdt-ext-es8311_sound {
            description = "ES8311 sound extension overlay";
            data = /incbin/("./dt/ext/es8311_sound.dtbo");
            type = "flat_dt";
            arch = "arm";
            compression = "none";
        };
        fdt-ext-lsm6ds3_pre0.4 {
            description = "LSM6DS3 pre-0.4 extension overlay";
            data = /incbin/("./dt/ext/lsm6ds3_pre0.4.dtbo");
            type = "flat_dt";
            arch = "arm";
            compression = "none";
        };
        fdt-ext-cvbs {
            description = "TVE CVBS output extension overlay";
            data = /incbin/("./dt/ext/cvbs.dtbo");
            type = "flat_dt";
            arch = "arm";
            compression = "none";
        };
    };
};
```
