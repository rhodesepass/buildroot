## board/rhodesisland/epass/uboot.defconfig
```kconfig
CONFIG_ARM=y
CONFIG_ARCH_SUNXI=y
CONFIG_SYS_TEXT_BASE=0x81700000
CONFIG_SPL=y
CONFIG_IDENT_STRING=" Rhodes Island"
CONFIG_MACH_SUNIV=y
CONFIG_DRAM_CLK=204
CONFIG_DRAM_ZQ=0
CONFIG_SYS_CLK_FREQ=604000000
CONFIG_MMC_SUNXI_SLOT_EXTRA=1
CONFIG_MMC=y
# CONFIG_VIDEO_SUNXI is not set
CONFIG_SRGN_ST7701_INIT=y
CONFIG_SRGN_SPLASH=y
CONFIG_SRGN_LRADC=y
CONFIG_SPL_SPI_SUNXI=y
CONFIG_BOOTDELAY=0
CONFIG_BOOTCOMMAND="run distro_bootcmd;"
CONFIG_CONSOLE_MUX=y
CONFIG_CMD_DFU=y
CONFIG_CMD_MBR=y
CONFIG_CMD_MMC=y
CONFIG_CMD_FAT=y
CONFIG_FAT_WRITE=y
CONFIG_CMD_EXT4=y
CONFIG_DOS_PARTITION=y
CONFIG_CMD_PART=y
CONFIG_CMD_MTD=y
CONFIG_CMD_SETEXPR=y
CONFIG_CMD_USB_MASS_STORAGE=y
CONFIG_CMD_MTDPARTS=y
CONFIG_DEFAULT_DEVICE_TREE="suniv-f1c100s-generic"
# CONFIG_ENV_IS_IN_FAT is not set
CONFIG_USE_DEFAULT_ENV_FILE=y
CONFIG_DEFAULT_ENV_FILE="../../../board/rhodesisland/epass/uboot.env"
# CONFIG_NET is not set
CONFIG_DFU_TIMEOUT=y
CONFIG_DFU_MMC=y
CONFIG_DFU_SF=y
CONFIG_DFU_MTD=y
# CONFIG_USB_FUNCTION_FASTBOOT is not set
CONFIG_MTD=y
CONFIG_DM_MTD=y
CONFIG_MTD_SPI_NAND=y
CONFIG_DM_SPI_FLASH=y
CONFIG_SPI_FLASH_BAR=y
CONFIG_SPI_FLASH_WINBOND=y
CONFIG_PHY_SUN4I_USB=y
CONFIG_SPI=y
CONFIG_DM_SPI=y
CONFIG_USB_MUSB_GADGET=y
CONFIG_USB_GADGET_MANUFACTURER="Rhodes Island"
CONFIG_USB_GADGET_VBUS_DRAW=250
CONFIG_USB_GADGET_DOWNLOAD=y
# CONFIG_SYS_WHITE_ON_BLACK is not set
CONFIG_GZIP=y
```

## package/epass-fonts/Config.in
```kconfig
config BR2_PACKAGE_EPASS_FONTS
	bool "epass-fonts"
	help
	  Shared UI fonts for epass devices (body/title/display/icon).

	  Master fonts are subsetted on the host and installed to
	  /usr/share/fonts/epass. Also provides pkg-config 'epass-fonts'
	  (build-time: fontsdir / per-role paths) and /usr/bin/epass-font
	  (runtime path resolver).

	  https://github.com/rhodesepass/epass-fonts

if BR2_PACKAGE_EPASS_FONTS

config BR2_PACKAGE_EPASS_FONTS_CHARSET_FILES
	string "CJK charset files"
	default "board/rhodesisland/epass/fonts/charset/common.txt board/rhodesisland/epass/fonts/charset/operators.txt board/rhodesisland/epass/fonts/charset/literals.txt board/rhodesisland/epass/fonts/charset/anime_games.txt"
	help
	  Space-separated list of UTF-8 text files. Every character in
	  these files is kept in the subsetted CJK fonts (body/title).
	  Paths are relative to the Buildroot top directory.

config BR2_PACKAGE_EPASS_FONTS_ICONS_FILE
	string "icon codepoints file"
	default "board/rhodesisland/epass/fonts/icons.txt"
	help
	  File with hexadecimal codepoints (one per line, '#' comments)
	  kept in the subsetted icon font. Path is relative to the
	  Buildroot top directory.

endif
```
