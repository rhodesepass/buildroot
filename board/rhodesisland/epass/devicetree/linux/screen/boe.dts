#include <dt-bindings/display/st7701initseq.h>

/dts-v1/;
/plugin/;
/ {
    fragment@1 {
        target = <&st7701initseq>;
        __overlay__ {
            status = "okay";
            /* pclk_khz hact hfp hslen hbp vact vfp vslen vbp (panel-simple lattland_mostima_mode) */
            srgn,panel-timing = <24000 360 84 6 78 640 16 4 9>;
            init-sequence = <
                ST7701INIT_BEGIN_WRITE

                ST7701INIT_WRITE_COMMAND_8 0xFF
                ST7701INIT_WRITE_BYTES 5
                0x77 0x01 0x00 0x00 0x13

                ST7701INIT_WRITE_C8_D8 0xEF 0x08

                ST7701INIT_WRITE_COMMAND_8 0xFF
                ST7701INIT_WRITE_BYTES 5
                0x77 0x01 0x00 0x00 0x10

                ST7701INIT_WRITE_C8_D16 0xC0 0x4F 0x00
                ST7701INIT_WRITE_C8_D16 0xC1 0x10 0x0C
                ST7701INIT_WRITE_C8_D16 0xC2 0x07 0x0A

                /* x flip */
                ST7701INIT_WRITE_C8_D8 0xC7 0x04

                ST7701INIT_WRITE_COMMAND_8 0xC3
                ST7701INIT_WRITE_BYTES 3 0x82 0x18 0x0e

                ST7701INIT_WRITE_C8_D8 0xCC 0x10

                ST7701INIT_WRITE_COMMAND_8 0xB0
                ST7701INIT_WRITE_BYTES 16
                0x00 0x15 0x1D 0x0C
                0x10 0x05 0x0C 0x07
                0x05 0x29 0x03 0x11
                0x0F 0x30 0x36 0x1F

                ST7701INIT_WRITE_COMMAND_8 0xB1
                ST7701INIT_WRITE_BYTES 16
                0x00 0x12 0x18 0x0C
                0x10 0x06 0x02 0x09
                0x0A 0x1E 0x06 0x12
                0x10 0x26 0x2E 0x1F

                ST7701INIT_WRITE_COMMAND_8 0xFF
                ST7701INIT_WRITE_BYTES 5
                0x77 0x01 0x00 0x00 0x11

                ST7701INIT_WRITE_C8_D8 0xB0 0x45
                ST7701INIT_WRITE_C8_D8 0xB1 0x60
                ST7701INIT_WRITE_C8_D8 0xB2 0x81
                ST7701INIT_WRITE_C8_D8 0xB3 0x80
                ST7701INIT_WRITE_C8_D8 0xB5 0x4E
                ST7701INIT_WRITE_C8_D8 0xB7 0x85
                ST7701INIT_WRITE_C8_D8 0xB8 0x33
                ST7701INIT_WRITE_C8_D8 0xC0 0x89
                ST7701INIT_WRITE_C8_D8 0xB9 0x10
                ST7701INIT_WRITE_C8_D8 0xC1 0x78
                ST7701INIT_WRITE_C8_D8 0xC2 0x78
                ST7701INIT_WRITE_C8_D8 0xD0 0x88

                ST7701INIT_WRITE_COMMAND_8 0xE0
                ST7701INIT_WRITE_BYTES 3
                0x00 0x00 0x02

                ST7701INIT_WRITE_COMMAND_8 0xE1
                ST7701INIT_WRITE_BYTES 11
                0x05 0x28 0x00 0x28
                0x06 0x28 0x00 0x28
                0x0E 0x40 0x40

                ST7701INIT_WRITE_COMMAND_8 0xE2
                ST7701INIT_WRITE_BYTES 13
                0x20 0x20 0x40 0x40
                0x97 0x00 0x00 0x00
                0x97 0x8C 0x00 0x8C
                0x00

                ST7701INIT_WRITE_COMMAND_8 0xE3
                ST7701INIT_WRITE_BYTES 4
                0x00 0x00 0x22 0x22

                ST7701INIT_WRITE_C8_D16 0xE4 0x44 0x44

                ST7701INIT_WRITE_COMMAND_8 0xE5
                ST7701INIT_WRITE_BYTES 16
                0x0D 0x93 0x2C 0x8C
                0x0F 0x95 0x2C 0x8C
                0x09 0x8F 0x2C 0x8C
                0x0B 0x91 0x2C 0x8C

                ST7701INIT_WRITE_COMMAND_8 0xE6
                ST7701INIT_WRITE_BYTES 4
                0x00 0x00 0x22 0x22

                ST7701INIT_WRITE_C8_D16 0xE7 0x44 0x44

                ST7701INIT_WRITE_COMMAND_8 0xE8
                ST7701INIT_WRITE_BYTES 16
                0x0C 0x92 0x2C 0x8C
                0x0E 0x94 0x2C 0x8C
                0x08 0x8E 0x2C 0x8C
                0x0A 0x90 0x2C 0x8C

                ST7701INIT_WRITE_COMMAND_8 0xEB
                ST7701INIT_WRITE_BYTES 7
                0x00 0x01 0x4E 0x4E
                0x44 0x88 0x40

                ST7701INIT_WRITE_C8_D16 0xEC 0x7D 0x00

                ST7701INIT_WRITE_COMMAND_8 0xED
                ST7701INIT_WRITE_BYTES 16
                0x77 0x66 0x55 0x44
                0xA8 0x9F 0x02 0xFF
                0xFF 0x20 0xF9 0x8A
                0x44 0x55 0x66 0x77

                ST7701INIT_WRITE_COMMAND_8 0xEF
                ST7701INIT_WRITE_BYTES 6
                0x08 0x08 0x08 0x45
                0x3F 0x54

                ST7701INIT_WRITE_COMMAND_8 0xFF
                ST7701INIT_WRITE_BYTES 5
                0x77 0x01 0x00 0x00 0x13

                ST7701INIT_WRITE_C8_D16 0xE8 0x00 0x0E
                ST7701INIT_WRITE_C8_D8 0x3A 0x50

                ST7701INIT_WRITE_COMMAND_8 0xFF
                ST7701INIT_WRITE_BYTES 5
                0x77 0x01 0x00 0x00 0x00

                ST7701INIT_WRITE_COMMAND_8 0x11
                ST7701INIT_END_WRITE

                ST7701INIT_DELAY 120

                ST7701INIT_BEGIN_WRITE
                ST7701INIT_WRITE_COMMAND_8 0xFF
                ST7701INIT_WRITE_BYTES 5
                0x77 0x01 0x00 0x00 0x13

                ST7701INIT_WRITE_C8_D16 0xE8 0x00 0x0C
                ST7701INIT_END_WRITE

                ST7701INIT_DELAY 10

                ST7701INIT_BEGIN_WRITE
                ST7701INIT_WRITE_C8_D16 0xE8 0x00 0x00

                ST7701INIT_WRITE_COMMAND_8 0xFF
                ST7701INIT_WRITE_BYTES 5
                0x77 0x01 0x00 0x00 0x00

                ST7701INIT_WRITE_COMMAND_8 0x29
                ST7701INIT_END_WRITE

                ST7701INIT_DELAY 20

                ST7701INIT_BEGIN_WRITE
                ST7701INIT_WRITE_C8_D8 0x35 0x00
                ST7701INIT_END_WRITE
            >;
        };
    };

    fragment@2 {
        target = <&panel>;
        __overlay__ {
            compatible = "lattland,mostima", "simple-panel";
        };
    };

    fragment@3 {
        target = <&be0>;
        __overlay__ {
            srgn,scanout-yflip;
        };
    };
};